## arch/arm64/configs/mrkernel_defconfig
```kconfig
CONFIG_LOCALVERSION="-mrkernel"
CONFIG_CC_OPTIMIZE_FOR_PERFORMANCE=y
CONFIG_DEBUG_KERNEL=n
CONFIG_SCHED_CORE=y
CONFIG_LRU_GEN=y
CONFIG_ZRAM=y
CONFIG_ZRAM_WRITEBACK=y
```
