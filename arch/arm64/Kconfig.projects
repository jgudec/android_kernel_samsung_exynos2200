## arch/arm64/Kconfig.projects
```kconfig
config SEC_B0S_PROJECT
        depends on ARCH_EXYNOS
	default n
	bool "Samsung B0S Project"
	help
	  Support for Samsung B0S Project

config SEC_G0S_PROJECT
        depends on ARCH_EXYNOS
	default n
	bool "Samsung G0S Project"
	help
	  Support for Samsung G0S Project

config SEC_R0S_PROJECT
        depends on ARCH_EXYNOS
	default n
	bool "Samsung R0S Project"
	help
	  Support for Samsung R0S Project
```

## arch/arm64/configs/loki_defconfig
```kconfig
## LOKI KERNEL CONFIG

## WAKELOCK BLOCKER
CONFIG_BOEFFLA_WL_BLOCKER=y

#
# Boot options
#
CONFIG_CMDLINE="stack_depot_disable=on kasan.stacktrace=off kvm-arm.mode=protected cgroup_disable=pressure cgroup.memory=nokmem androidboot.boot_devices=11100000.ufs"
# CONFIG_CMDLINE_FROM_BOOTLOADER is not set
CONFIG_CMDLINE_EXTEND=y
# CONFIG_CMDLINE_FORCE is not set
CONFIG_EFI_STUB=y
CONFIG_EFI=y
# CONFIG_DMI is not set
# end of Boot options
```
